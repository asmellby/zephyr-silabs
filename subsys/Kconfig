## subsys/Kconfig
```kconfig
# Copyright (c) 2026 Silicon Laboratories Inc.
# SPDX-License-Identifier: Apache-2.0

menu "Subsystems"

rsource "net/Kconfig"

endmenu
```

## subsys/net/Kconfig
```kconfig
# Copyright (c) 2026 Silicon Laboratories Inc.
# SPDX-License-Identifier: Apache-2.0

menu "Networking"

rsource "openthread/Kconfig"

endmenu
```

## subsys/net/openthread/Kconfig
```kconfig
# Copyright (c) 2026 Silicon Laboratories Inc.
# SPDX-License-Identifier: Apache-2.0

if OPENTHREAD

config OPENTHREAD_LIBRARY_SUPPORTED
	bool
	default y
	depends on OPENTHREAD_THREAD_VERSION_1_4
	depends on !OPENTHREAD_COPROCESSOR
	
	# TODO: Add additional rules

choice OPENTHREAD_IMPLEMENTATION
	default OPENTHREAD_SOURCES

config OPENTHREAD_LIBRARY
	bool "OpenThread prebuilt stack library"
	select OPENTHREAD_DIAG
	help
	  Use prebuilt OpenThread stack libraries that could be used for certification by
	  inheritance. Uses default certification configurations. Note: Please refer to the
	  release notes for Simplicity SDK to verify if the SDK has been qualified for
	  certification.

endchoice

if OPENTHREAD_LIBRARY

config OPENTHREAD_LIBRARY_DEFAULT
	bool
	default y if !OPENTHREAD_MULTIPLE_INSTANCE && !OPENTHREAD_COAP

config OPENTHREAD_LIBRARY_COAP
	default y if !OPENTHREAD_MULTIPLE_INSTANCE && OPENTHREAD_COAP
	bool

config OPENTHREAD_LIBRARY_COAP_MI
	bool
	default y if OPENTHREAD_MULTIPLE_INSTANCE && OPENTHREAD_COAP

endif

endif
```

## tests/crypto/psa_crypto/testcase.yaml
```yaml
# SPDX-License-Identifier: Apache-2.0
# Copyright (c) 2025 Silicon Laboratories Inc.
common:
  tags:
    - crypto
    - psa_crypto
    - drivers
  extra_configs:
    # a bigger stack is needed for mpi math
    - CONFIG_TEST_EXTRA_STACK_SIZE=2048
tests:
  crypto.psa_crypto.default:
    platform_allow:
      - xg24_dk2601b
      - xg24_rb4187c
      - xg27_dk2602a
      - xg29_rb4412a
      - siwx917_rb4338a
    extra_configs:
      - CONFIG_MBEDTLS_PSA_STATIC_KEY_SLOTS=n
  crypto.psa_crypto.sw_only:
    platform_allow:
      - xg24_dk2601b
      - xg24_rb4187c
      - xg27_dk2602a
      - xg29_rb4412a
      - siwx917_rb4338a
    extra_configs:
      - CONFIG_PSA_CRYPTO_SW_ONLY=y
      - CONFIG_MBEDTLS_PSA_P256M_DRIVER_ENABLED=y
  crypto.psa_crypto.siwx91x:
    platform_allow:
      - siwx917_rb4338a
    extra_configs:
      - CONFIG_PSA_CRYPTO_DRIVER_SILABS_SIWX91X=y
```
